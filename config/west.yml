## config/west.yml
```yaml
manifest:
  remotes:
    - name: zmkfirmware
      url-base: https://github.com/zmkfirmware
    - name: iwk7273
      url-base: https://github.com/iwk7273
  projects:
    - name: zmk
      remote: zmkfirmware
      revision: main
      import: app/west.yml
    - name: zmk-pmw3610-driver
      remote: iwk7273
      revision: main
    - name: zmk-feature-sensor_rotation
      remote: iwk7273
      revision: main
    - name: zmk-feature-xy_clipper
      remote: iwk7273
      revision: main
    - name: zmk-feature-scaling
      remote: iwk7273
      revision: main
    - name: zmk-smart-toggle
      remote: iwk7273
      revision: main
    - name: zmk-feature-meteorite-config
      remote: iwk7273
      revision: main
    # 直接URLを指定することで、リポジトリ取得エラーを回避します
    - name: prospector-zmk-module
      url: https://github.com/t-ogura/prospector-zmk-module
      revision: main
      path: modules/prospector-zmk-module
  self:
    path: config
```
